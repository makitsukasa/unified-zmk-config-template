#include <behaviors.dtsi>
#include <dt-bindings/zmk/keys.h>

 / {
    keymap {
        compatible = "zmk,keymap";

        default_layer {
            bindings = <
                &kp A   /* 左 */
                &kp B   /* 右 */
            >;
        };
    };
};
