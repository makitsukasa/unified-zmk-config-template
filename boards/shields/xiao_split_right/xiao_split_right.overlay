/ {
    chosen {
        zmk,kscan = &kscan0;
    };

    kscan0: kscan {
        compatible = "zmk,kscan-gpio-matrix";
        label = "KSCAN";

        row-gpios = <
            &gpio0 2 GPIO_ACTIVE_LOW
        >;
        col-gpios = <
            &gpio0 3 (GPIO_ACTIVE_LOW | GPIO_PULL_UP)
        >;
    };
};
