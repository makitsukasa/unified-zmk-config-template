#include <behaviors.dtsi>
#include <dt-bindings/zmk/keys.h>

/ {
    keymap {
        compatible = "zmk,keymap";

        default_layer {
            bindings = <
                &kp A    // 左 (index 0)
                &kp B    // 右 (index 1)
            >;
        };
    };
};
