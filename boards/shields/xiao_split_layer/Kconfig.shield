## boards/shields/xiao_split_layer/Kconfig.shield
```kconfig
config SHIELD_XIAO_SPLIT_LAYER_LEFT
    def_bool $(shields_list_contains,xiao_split_layer_left)

config SHIELD_XIAO_SPLIT_LAYER_RIGHT
    def_bool $(shields_list_contains,xiao_split_layer_right)
```

## config/dts/bindings/behaviors/zmk,behavior-battery.yaml
```yaml
description: |
  Minimal device tree binding for the custom ZMK battery behavior.
compatible: zmk,behavior-battery
```

## config/dts/bindings/behaviors/zmk,behavior-fixed-typer.yaml
```yaml
description: "Fixed Typer Behavior"
compatible: "zmk,behavior-fixed-typer"
binding-cells:
  - 0
```

## modules/zmk-battery-behavior/dts/bindings/behaviors/zmk,behavior-battery.yaml
```yaml
description: Battery Usage Behavior
compatible: zmk,behavior-battery
properties: {}
required: []
```
