## boards/shields/xiao_split/Kconfig.shield
```kconfig
config SHIELD_XIAO_SPLIT_LEFT
    def_bool $(shields_list_contains,xiao_split_left)

config SHIELD_XIAO_SPLIT_RIGHT
    def_bool $(shields_list_contains,xiao_split_right)
```

## config/Kconfig
```kconfig
config ZMK_BEHAVIOR_FIXED_TYPER
    bool "Fixed Typer Behavior"
    default y
    depends on ZMK
```

## modules/zmk-battery-behavior/Kconfig
```kconfig
config ZMK_BATTERY_BEHAVIOR
    bool "Enable battery text behavior"
    default y
    depends on ZMK
```
